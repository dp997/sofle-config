## boards/shields/sofle997/Kconfig.shield
```kconfig
config SHIELD_SOFLE_LEFT
  def_bool $(shields_list_contains,sofle997_left)

config SHIELD_SOFLE_RIGHT
  def_bool $(shields_list_contains,sofle997_right)

config SHIELD_SOFLE_DONGLE
  def_bool $(shields_list_contains,sofle997_dongle)
```
